## main/Kconfig.projbuild
```kconfig
menu "A2DP Example Configuration"

    config EXAMPLE_LM1972_LD_PIN
        int "LM1972 LD GPIO"
        default 5
        help
            GPIO number to use for LM1972 driver.

    config EXAMPLE_LM1972_DIN_PIN
        int "LM1972 DIN GPIO"
        default 18
        help
            GPIO number to use for LM1972 driver.

    config EXAMPLE_LM1972_CLK_PIN
        int "LM1972 CLK GPIO"
        default 19
        help
            GPIO number to use for LM1972 driver.

    config EXAMPLE_I2S_LRCK_PIN
        int "I2S LRCK (WS) GPIO"
        default 22
        help
            GPIO number to use for I2S LRCK(WS) Driver.

    config EXAMPLE_I2S_BCK_PIN
        int "I2S BCK GPIO"
        default 26
        help
            GPIO number to use for I2S BCK Driver.

    config EXAMPLE_I2S_DATA_PIN
        int "I2S DATA GPIO"
        default 25
        help
            GPIO number to use for I2S Data Driver.

endmenu
```
